/dts-v1/;
/plugin/;

/ {
    fragment@0 {
        target = <&fpga_full>;

        __overlay__ {
            #address-cells = <2>;
            #size-cells = <2>;
            firmware-name = "z486_led.bit.bin";
            resets = <&zynqmp_reset 116>, <&zynqmp_reset 117>,
                     <&zynqmp_reset 118>, <&zynqmp_reset 119>;
        };
    };
};
